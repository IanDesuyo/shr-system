#include <SoftwareSerial.h>
#include "src/Adafruit_MLX90614_Library/Adafruit_MLX90614.h"
#include "src/ArduinoJWT/src/ArduinoJWT.h"
#include "src/SSD1306Ascii/src/SSD1306Ascii.h"
#include "src/SSD1306Ascii/src/SSD1306AsciiWire.h"

#define BTN 4 // trigger button's pin
#define BT_TX 10 // the pin connect to bt module's TX and RX, Nano should set to 10, 11
#define BT_RX 11
#define OLED_ADDRESS 0x3C
#define MLX_ADDRESS 0x5A

SSD1306AsciiWire oled;
SoftwareSerial SerialBt(BT_TX, BT_RX);
Adafruit_MLX90614 mlx = Adafruit_MLX90614(MLX_ADDRESS);
ArduinoJWT jwt = ArduinoJWT("{PSK}");
// variables
float temp;
String response;
int randNum;
int displayOffCount = 0;

const unsigned char logo[] PROGMEM = {
  // ', 64x64px
  0x00, 0x00, 0x00, 0x00, 0x00, 0x00, 0x00, 0x00, 0xf8, 0xfc, 0x0c, 0x0c, 0x0c, 0x0c, 0x0c, 0x0c,
  0x0c, 0x0c, 0x0c, 0x0c, 0x0c, 0x0c, 0x0c, 0x0c, 0x0c, 0x8c, 0x8c, 0x8c, 0x8c, 0x8c, 0x8c, 0x0c,
  0x0c, 0x0c, 0x0c, 0x0c, 0x0c, 0x0c, 0x0c, 0x0c, 0x0c, 0x0c, 0x0c, 0x0c, 0x0c, 0x0c, 0xfc, 0xf8,
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  0x00, 0x00, 0x00, 0x01, 0x0f, 0x3f, 0x3f, 0x0f, 0x01, 0x00, 0x00, 0x00, 0x00, 0x00, 0x00, 0x00
};

const unsigned char bluetooth[] PROGMEM = {
  // 'bluetooth-brands, 26x30px
  0x00, 0x00, 0x00, 0xc0, 0xf0, 0xf8, 0xfc, 0xfe, 0xfe, 0xff, 0xff, 0xff, 0x07, 0x07, 0x1f, 0x3f,
  0x7f, 0xfe, 0xfe, 0xfc, 0xfc, 0xf0, 0xe0, 0x00, 0x00, 0x00, 0x00, 0x00, 0xfe, 0xff, 0xff, 0xff,
  0xff, 0xf9, 0xf1, 0xe3, 0xc7, 0x8f, 0x00, 0x00, 0x0f, 0x8e, 0xe4, 0xf0, 0xf9, 0xff, 0xff, 0xff,
  0xff, 0xff, 0x00, 0x00, 0x00, 0x00, 0x3f, 0xff, 0xff, 0xff, 0xff, 0xcf, 0xc7, 0xe3, 0xf1, 0xf8,
  0x00, 0x00, 0x38, 0x38, 0x11, 0x83, 0xc7, 0xff, 0xff, 0xff, 0xff, 0x3f, 0x00, 0x00, 0x00, 0x00,
  0x00, 0x01, 0x03, 0x07, 0x0f, 0x1f, 0x1f, 0x3f, 0x3f, 0x3f, 0x3e, 0x38, 0x3c, 0x3e, 0x3f, 0x1f,
  0x1f, 0x1f, 0x0f, 0x07, 0x01, 0x00, 0x00, 0x00
};

void setup()
{
  Serial.begin(9600);
  SerialBt.begin(9600);
  pinMode(BTN, INPUT);
  mlx.begin();
  oled.begin(&Adafruit128x64, OLED_ADDRESS);
  oled.setFont(ZevvPeep8x16);
  oled.clear();
  byte r = 1;
  byte c = 32;
  int a = 0;
  for (byte b = 0; b < 8; b++) {
    oled.setCursor (c, (r + b));
    for (byte i = 0; i < 64; i++) {
      oled.ssd1306WriteRam(pgm_read_byte(&logo[a]));
      a++;
    }
  }
  delay(2000);
  oled.clear();
  oled.set1X();
  oled.println("Hello!");
  oled.println("Starting...");
  oled.println();
  oled.print("\nuuid: ");
  oled.print("{UUID}");
  delay(1000);
  oled.clear();
}

void loop()
{
  if (digitalRead(BTN)) {
    oled.clear();
    oled.set1X();
    oled.println("\nMeasuring...");
    temp = 0;
    for (int i = 0; i < 5; i++) {
      temp += mlx.readObjectTempC();
      delay(200);
    }
    temp /= 5;
    randNum = random(10000);
    oled.clear();
    oled.println("\nTemperature: ");
    oled.set2X();
    oled.print(temp);
    oled.print("'C");
    response = jwt.encodeJWT("{\"temp\":" + String(temp) + ", \"uuid\":\"{UUID}\", \"rand\":" + randNum + "}");
    Serial.println(temp);
    SerialBt.println(response);
    delay(1000);
    displayOffCount = 1;
  }
  else if (displayOffCount == 4000) {
    displayOffCount = 0;
    oled.clear();
  }
  else if (displayOffCount >= 1) {
    displayOffCount ++;
  }
  delay(1);
}
